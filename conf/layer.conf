## conf/layer.conf
```bitbake
BBPATH .= ":${LAYERDIR}"

BBFILES += "${LAYERDIR}/recipes-*/*/*.bb \
	${LAYERDIR}/recipes-*/*/*.bbappend"

BBFILE_COLLECTIONS += "raspberrypi-bsp"
BBFILE_PATTERN_raspberrypi-bsp = "^${LAYERDIR}/"
BBFILE_PRIORITY_raspberrypi-bsp = "9"

LAYERSERIES_COMPAT_raspberrypi-bsp = "wrynose"
LAYERDEPENDS_raspberrypi-bsp = "core"
```

## conf/machine/include/raspberrypi.inc
```bitbake
#@TYPE: Machine
#@NAME: Raspberry Pi common config
#@DESCRIPTION: Common machine configuration for the Raspberry Pi

MACHINEOVERRIDES = "raspberrypi:${MACHINE}:"

IMAGE_FSTYPES ?= "tar.bz2 wic.bz2"
WKS_FILE ?= "sdimage-raspberrypi.wks"

MACHINE_EXTRA_RRECOMMENDS += "kernel-modules"

EXTRA_IMAGEDEPENDS += "u-boot u-boot-env rpi-firmware"
do_image_wic[depends] += " \
    virtual/kernel:do_deploy \
    rpi-firmware:do_deploy \
    u-boot:do_deploy \
    u-boot-env:do_deploy \
    "


IMAGE_FSTYPES += "tar.bz2"

PREFERRED_PROVIDER_virtual/kernel ?= "linux-mainline"
PREFERRED_VERSION_virtual/kernel = "6.8%"
PREFERRED_PROVIDER_virtual/bootloader ?= "u-boot"

UBOOT_MACHINE = "${MACHINE}_defconfig"

MACHINE_FEATURES += " \
    usbgadget \
    usbhost \
    vfat \
    ext2 \
    alsa \
    bluetooth \
    wifi \
    "

def get_dtb_files(d):
    paths = d.getVar("KERNEL_DEVICETREE").split()
    dtb_files = ""
    for path in paths:
        dtb_files += " " + path.split("/")[-1]
    return dtb_files


IMAGE_BOOT_FILES ?= "u-boot.bin boot.scr ${KERNEL_IMAGETYPE} ${@get_dtb_files(d)} firmware/* config.txt"
```

## conf/machine/raspberrypi.inc
```bitbake
#@TYPE: Machine
#@NAME: Raspberry Pi common config
#@DESCRIPTION: Common machine configuration for the Raspberry Pi

MACHINEOVERRIDES = "raspberrypi:${MACHINE}:"

IMAGE_FSTYPES ?= "tar.bz2 wic.bz2"
WKS_FILE ?= "sdimage-${MACHINE}.wks"

MACHINE_EXTRA_RRECOMMENDS += "\
    kernel-modules \
    linux-firmware \
    "

EXTRA_IMAGEDEPENDS += "u-boot rpi-firmware"
do_image_wic[depends] += " \
    virtual/kernel:do_deploy \
    rpi-firmware:do_deploy \
    u-boot:do_deploy \
    "


IMAGE_FSTYPES += "tar.bz2"

PREFERRED_PROVIDER_virtual/kernel ?= "linux-mainline"
PREFERRED_VERSION_linux-mainline ?= "6.19%"
PREFERRED_PROVIDER_virtual/bootloader ??= "u-boot"

UBOOT_MACHINE = "${MACHINE}_defconfig"

MACHINE_FEATURES += " \
    usbgadget \
    usbhost \
    vfat \
    ext2 \
    alsa \
    bluetooth \
    wifi \
    "

def get_dtb_files(d):
    paths = d.getVar("KERNEL_DEVICETREE").split()
    dtb_files = ""
    for path in paths:
        dtb_files += " " + path.split("/")[-1]
    return dtb_files


IMAGE_BOOT_FILES ?= "u-boot.bin boot.scr ${KERNEL_IMAGETYPE} ${@get_dtb_files(d)} firmware/* config.txt cmdline.txt"
```

## conf/machine/raspberrypi1.conf
```bitbake
#@TYPE: Machine
#@NAME: Raspberry Pi 1

#@DESCRIPTION: Machine configuration for the Raspberry Pi 1

require conf/machine/include/tune-arm1176jzf-s.inc
include conf/machine/include/raspberrypi.inc

KERNEL_DEVICETREE = " \
    bcm2708-rpi-b.dtb \
    bcm2708-rpi-b-plus.dtb \
    "

DEFAULTTUNE = "arm1176jzfshf"

UBOOT_MACHINE = "rpi_defconfig"

IMAGE_BOOT_FILES_append = " zImage-bcm2708-rpi-b.dtb zImage-bcm2708-rpi-b-plus.dtb"
```

## conf/machine/raspberrypi2.conf
```bitbake
#@TYPE: Machine
#@NAME: Raspberry Pi 2

#@DESCRIPTION: Machine configuration for the Raspberry Pi 2

include conf/machine/include/tune-cortexa7.inc
include conf/machine/include/raspberrypi.inc

KERNEL_DEVICETREE = " \
    bcm2709-rpi-2-b.dtb \
    "

DEFAULTTUNE = "cortexa7hf-neon-vfpv4"

UBOOT_MACHINE = "rpi_2_defconfig"

IMAGE_BOOT_FILES_append = " zImage-bcm2709-rpi-2-b.dtb"
```

## conf/machine/raspberrypi3.conf
```bitbake
#@TYPE: Machine
#@NAME: Raspberry Pi 3
#@DESCRIPTION: Machine configuration for the Raspberry Pi 3

require conf/machine/include/arm/armv8a/tune-cortexa53.inc
require conf/machine/include/raspberrypi.inc

KERNEL_IMAGETYPE = "Image"

KERNEL_DEVICETREE = " \
    broadcom/bcm2837-rpi-3-a-plus.dtb \
    broadcom/bcm2837-rpi-3-b.dtb \
    broadcom/bcm2837-rpi-3-b-plus.dtb \
    broadcom/bcm2837-rpi-zero-2-w.dtb \
    "

# getty will use this as a login console
SERIAL_CONSOLES = "115200;ttyS1"

DEFAULTTUNE = "cortexa53"
```

## conf/machine/raspberrypi4.conf
```bitbake
#@TYPE: Machine
#@NAME: Raspberry Pi 4
#@DESCRIPTION: Machine configuration for the Raspberry Pi 4

require conf/machine/include/arm/armv8a/tune-cortexa72.inc
require conf/machine/raspberrypi.inc

MACHINE_FEATURES += "pci"

KERNEL_IMAGETYPE = "Image"

KERNEL_DEVICETREE = " \
    broadcom/bcm2711-rpi-4-b.dtb \
    "

# getty will use this as a login console
SERIAL_CONSOLES = "115200;ttyS1"
```

## files/wic/sdimage-raspberrypi4.wks
```
part /boot --source bootimg-partition --ondisk mmcblk1 --fstype=vfat --label boot --active --align 4096 --fixed-size 100M
part / --source rootfs --ondisk mmcblk1 --fstype=ext4 --label root --align 4096 --extra-space 200M
```

## wic/sdimage-raspberrypi.wks
```
part /boot --source bootimg-partition --ondisk mmcblk0 --fstype=vfat --label boot --active --align 4096 --fixed-size 100M
part / --source rootfs --ondisk mmcblk0 --fstype=ext4 --label root --align 4096 --extra-space 200M
```
